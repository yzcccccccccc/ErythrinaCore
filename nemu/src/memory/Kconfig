## nemu/src/memory/Kconfig
```kconfig
menu "Memory Configuration"

config YSYXSOC
  bool "Use ysyxSoC environment"
  default n

config MROM_BASE
  depends on YSYXSOC
  hex "MROM base addr"
  default 0x20000000

config MROM_SIZE
  depends on YSYXSOC
  hex "MROM size"
  default 0xffff

config SRAM_BASE
  depends on YSYXSOC
  hex "SRAM base addr"
  default 0x0f000000

config SRAM_SIZE
  depends on YSYXSOC
  hex "SRAM size"
  default 0x1fff

config MBASE
  hex "Memory base address"
  default 0x0        if ISA_x86
  default 0x80000000

config MSIZE
  hex "Memory size"
  default 0x8000000

config PC_RESET_OFFSET
  hex "Offset of reset vector from the base of memory"
  default 0x100000 if ISA_x86
  default 0

choice
  prompt "Physical memory definition"
  default PMEM_GARRAY
config PMEM_MALLOC
  bool "Using malloc()"
config PMEM_GARRAY
  depends on !TARGET_AM
  bool "Using global array"
endchoice

config MEM_RANDOM
  depends on MODE_SYSTEM && !DIFFTEST && !TARGET_AM
  bool "Initialize the memory with random values"
  default y
  help
    This may help to find undefined behaviors.

endmenu #MEMORY
```
